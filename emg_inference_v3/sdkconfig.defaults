## emg_inference_v3/sdkconfig.defaults
```kconfig
# XIAO ESP32-S3 Sense
CONFIG_ESPTOOLPY_FLASHSIZE_8MB=y
CONFIG_ESPTOOLPY_FLASHSIZE="8MB"
CONFIG_SPIRAM=y
CONFIG_SPIRAM_MODE_OCT=y
CONFIG_SPIRAM_SPEED_80M=y
CONFIG_SPIRAM_USE_MALLOC=y
CONFIG_FREERTOS_HZ=1000
CONFIG_ADC_SUPPRESS_DEPRECATE_WARN=y
CONFIG_LOG_DEFAULT_LEVEL_INFO=y

# Task watchdog timeout increased to 10s (default 5s)
CONFIG_ESP_TASK_WDT_TIMEOUT_S=10
CONFIG_ESP_TASK_WDT_CHECK_IDLE_TASK_CPU0=n
CONFIG_ESP_TASK_WDT_CHECK_IDLE_TASK_CPU1=n

# Bluetooth
CONFIG_BT_ENABLED=y
CONFIG_BT_BLUEDROID_ENABLED=y
CONFIG_BT_BLE_ENABLED=y
CONFIG_BT_BLE_42_FEATURES_SUPPORTED=y

# NVS — required for BLE pairing key storage
CONFIG_NVS_ENCRYPTION=n

# HID profile
CONFIG_BT_HID_DEVICE_ENABLED=y

# esp_hid component
CONFIG_ESP_HID_ENABLED=y
CONFIG_BT_HID_ENABLED=y
CONFIG_BT_BLUEDROID_ENABLED=y
CONFIG_BT_BLE_ENABLED=y
CONFIG_BT_BLE_42_FEATURES_SUPPORTED=y
CONFIG_BT_ENABLED=y
CONFIG_NVS_ENCRYPTION=n
```
